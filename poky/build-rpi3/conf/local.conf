## poky/build-rpi3/conf/local.conf
```bitbake
# Local configuration for meta-rpi images
# Yocto Project 3.0 Poky distribution [zeus] branch
# This is a sysvinit system

# mask wireguard from meta-openembedded/meta-networking
# use version in meta-jumpnow to support kernels < 5.6
# with wireguard-linux-compat
BBMASK = "meta-networking/recipes-kernel/wireguard"

# mask cryptodev from poky/meta
# use version from meta-jumpnow to support kernels > 5.4
BBMASK += "meta/recipes-kernel/cryptodev"

LICENSE_FLAGS_WHITELIST = "commercial"

DISTRO_FEATURES += "ext2 usbhost ${DISTRO_FEATURES_LIBC} wifi ipv4 ipv6 virtualization"

PREFERRED_PROVIDER_udev = "eudev"
VIRTUAL-RUNTIME_init_manager = "sysvinit"

MACHINE_FEATURES_remove = "apm"

IMAGE_FSTYPES = "rpi-sdimg cpio.gz.u-boot"
#IMAGE_CLASSES += "image_types_uboot"

# Choose the board you are building for
#MACHINE = "raspberrypi"
#MACHINE = "raspberrypi0"
#MACHINE = "raspberrypi0-wifi"
#MACHINE = "raspberrypi2"
MACHINE = "raspberrypi3"
#MACHINE = "raspberrypi4"
#MACHINE = "raspberrypi-cm"
#MACHINE = "raspberrypi-cm3"

# Choices are Image or zImage if NOT using u-boot (no u-boot is the default)
# Choices are uImage or zImage if using u-boot, though if you choose zImage
# with u-boot you will also have to change the boot script boot command
KERNEL_IMAGETYPE = "uImage"

# uncomment for kernels < 5.6
WIREGUARD_COMPAT = "1"

DISABLE_VC4GRAPHICS = "1"
DISABLE_OVERSCAN = "1"
ENABLE_UART = "1"
ENABLE_RPI3_SERIAL_CONSOLE = "1"
SERIAL_CONSOLES = "115200;ttyAMA0"
# SERIAL_CONSOLES_forcevariable = ""

PREFERRED_VERSION_linux-raspberrypi = "4.19.%"

# DL_DIR = "/src/oe"
# SSTATE_DIR = "/oe6/rpi/sstate-cache"
# TMPDIR = "/oe6/rpi/tmp-zeus"

DISTRO = "poky"
PACKAGE_CLASSES = "package_ipk"

# i686 or x86_64
SDKMACHINE = "x86_64"

# for no root passwd uncomment the following and comment the two extra user lines
EXTRA_IMAGE_FEATURES = "debug-tweaks"

# for a root passwd, change jumpnowtek below to your password
#INHERIT += "extrausers"
#EXTRA_USERS_PARAMS = "usermod -P jumpnowtek root; "

# this will force root to change password on first login
#INHERIT += "chageusers"
#CHAGE_USERS_PARAMS = "chage -d0 root; "

USER_CLASSES = "image-mklibs image-prelink"
PATCHRESOLVE = "noop"
RM_OLD_IMAGE = "1"
INHERIT += "rm_work"
CONF_VERSIOo = "1"

# IMAGE_INSTALL_append="hurracloud"
#ENABLE_DWC2_PERIPHERAL = "1"
#KERNEL_MODULE_AUTOLOAD_rpi += "dwc2 g_serial"
HDMI_GROUP = "1"
HDMI_MODE = "4"
HDMI_SAFE = "1"

RPI_USE_U_BOOT = "1"
GPU_MEM="16"
#RPI_EXTRA_CONFIG="dtoverlay=dwc2"
```

## yocto/build-rpi3/conf/bblayers.conf
```bitbake
# POKY_BBLAYERS_CONF_VERSION is increased each time build/conf/bblayers.conf
# changes incompatibly
POKY_BBLAYERS_CONF_VERSION = "2"

BBPATH = "${TOPDIR}"
BBFILES ?= ""

BBLAYERS ?= " \
    /home/vagrant/app/poky/meta \
    /home/vagrant/app/poky/meta-poky \
    /home/vagrant/app/poky/meta-yocto-bsp \
    /home/vagrant/app/meta-openembedded/meta-oe \
    /home/vagrant/app/meta-openembedded/meta-networking \
    /home/vagrant/app/meta-openembedded/meta-perl \
    /home/vagrant/app/meta-openembedded/meta-python \
    /home/vagrant/app/meta-openembedded/meta-filesystems \
    /home/vagrant/app/meta-openembedded/meta-webserver \
    /home/vagrant/app/meta-raspberrypi \
    /home/vagrant/app/meta-virtualization \
    /home/vagrant/app/meta-mender/meta-mender-core \
    /home/vagrant/app/meta-mender/meta-mender-raspberrypi \
    /home/vagrant/app/meta-hurracloud \
  "
```

## yocto/build-rpi3/conf/conf/local.conf
```bitbake
### 
MACHINE ??= "qemux86-64"
DISTRO ?= "poky"
PACKAGE_CLASSES ?= "package_rpm"
EXTRA_IMAGE_FEATURES ?= "debug-tweaks"
USER_CLASSES ?= "buildstats image-mklibs image-prelink"
PATCHRESOLVE = "noop"
PACKAGECONFIG_append_pn-qemu-system-native = " sdl"
CONF_VERSION = "1"

MENDER_ARTIFACT_NAME = "release-1"

INHERIT += "mender-full"

DISTRO_FEATURES_append = " systemd"
VIRTUAL-RUNTIME_init_manager = "systemd"
DISTRO_FEATURES_BACKFILL_CONSIDERED = "sysvinit"
VIRTUAL-RUNTIME_initscripts = ""

# Build for Hosted Mender
#
# To get your tenant token:
#    - log in to https://hosted.mender.io
#    - click your email at the top right and then "My organization"
#    - press the "COPY TO CLIPBOARD"
#    - assign content of clipboard to MENDER_TENANT_TOKEN
#
#MENDER_SERVER_URL = "https://hosted.mender.io"
#MENDER_TENANT_TOKEN = ""

# Build for Mender demo server
#
# https://docs.mender.io/getting-started/create-a-test-environment
#
# Uncomment below and update IP address to match the machine running the
# Mender demo server
#MENDER_DEMO_HOST_IP_ADDRESS = "192.168.0.100"

# Build for Mender production setup (on-prem)
#
# https://docs.mender.io/artifacts/building-for-production
#
# Uncomment below and update the URL to match your configured domain
# name and provide the path to the generated server.crt file.
#
# NOTE! It is recommend that you provide below information in your custom
# Yocto layer and this is only for demo purposes. See linked documentation
# for additional information.
#MENDER_SERVER_URL = "https://docker.mender.io"
#FILESEXTRAPATHS_prepend_pn-mender := "<DIRECTORY-CONTAINING-server.crt>:"
#SRC_URI_append_pn-mender = " file://server.crt"

# Mender storage configuration
#
# More details on these variables is available at
#    https://docs.mender.io/devices/yocto-project/partition-configuration#configuring-storage
#
# Also, please be sure to check other config files as other
# layers, config fragments, etc may attempt to set values
# for specific platforms.  Using "bitbake -e <image-name>"
# can help determine which files are setting these values
# in a given configuration.
#
# MENDER_STORAGE_TOTAL_SIZE_MB = "2048"
# MENDER_BOOT_PART_SIZE_MB = "16"
# MENDER_DATA_PART_SIZE_MB = "1024"
# MENDER_STORAGE_DEVICE = "/dev/mmcblk0"
# MENDER_BOOT_PART = "${MENDER_STORAGE_DEVICE_BASE}1"
# MENDER_DATA_PART = "${MENDER_STORAGE_DEVICE_BASE}4"
# MENDER_ROOTFS_PART_A = "${MENDER_STORAGE_DEVICE_BASE}2"
# MENDER_ROOTFS_PART_B = "${MENDER_STORAGE_DEVICE_BASE}3"

# Appended fragment from meta-mender-community/meta-mender-raspberrypi/templates

MACHINE ?= "raspberrypi3"

RPI_USE_U_BOOT = "1"
MENDER_BOOT_PART_SIZE_MB = "40"
IMAGE_INSTALL_append = " kernel-image kernel-devicetree"
IMAGE_FSTYPES_remove += " rpi-sdimg"

MENDER_FEATURES_ENABLE_append = " mender-uboot mender-image-sd"
MENDER_FEATURES_DISABLE_append = " mender-grub mender-image-uefi"
```

## yocto/build-rpi3/conf/local.conf
```bitbake
# Local configuration for meta-rpi images
# Yocto Project 3.0 Poky distribution [zeus] branch
LICENSE_FLAGS_WHITELIST = "commercial"

DISTRO_FEATURES += " ${DISTRO_FEATURES_LIBC} wifi ipv4 virtualization systemd"
DISTRO_FEATURES_BACKFILL_CONSIDERED = "sysvinit"
VIRTUAL-RUNTIME_init_manager = "systemd"
VIRTUAL-RUNTIME_initscripts = ""
MACHINE_FEATURES_remove = "apm"
MACHINE = "raspberrypi4-64"
DISABLE_SPLASH = "1"
ENABLE_UART = "1"
RPI_USE_U_BOOT = "1"

PREFERRED_VERSION_linux-raspberrypi = "5.4.%"

DISTRO = "poky"
PACKAGE_CLASSES = "package_ipk"

EXTRA_IMAGE_FEATURES = "debug-tweaks"
# for a root passwd, change jumpnowtek below to your password
# INHERIT += "extrausers"
# EXTRA_USERS_PARAMS = "usermod -P hurra root; "

# this will force root to change password on first login
#INHERIT += "chageusers"
#CHAGE_USERS_PARAMS = "chage -d0 root; "

IMAGE_INSTALL_append = " tzdata ruby redis elasticsearch bash zlib hurracloud hurracloud-agent wpa-supplicant docker-ce python3-docker-compose openssh avahi-daemon avahi-utils kernel-image kernel-devicetree"

# Mender
MENDER_ARTIFACT_NAME = "release-1"
INHERIT += "mender-full"
IMAGE_FSTYPES_remove += " rpi-sdimg"
MENDER_FEATURES_ENABLE_append = " mender-uboot mender-image-sd"
MENDER_FEATURES_DISABLE_append = " mender-grub mender-image-uefi"
MENDER_SERVER_URL = "https://mender.hurranet.net"
MENDER_STORAGE_TOTAL_SIZE_MB = "8192"
MENDER_BOOT_PART_SIZE_MB = "40"
SDIMG_ROOTFS_TYPE = "ext4"
ARTIFACTIMG_FSTYPE = "ext4"
```

## yocto/meta-hurracloud/conf/layer.conf
```bitbake
# We have a conf and classes directory, add to BBPATH
BBPATH .= ":${LAYERDIR}"

# We have recipes-* directories, add to BBFILES
BBFILES += "${LAYERDIR}/recipes-*/*/*.bb \
	${LAYERDIR}/recipes-*/*/*.bbappend"

BBFILE_COLLECTIONS += "hurracloud"
BBFILE_PATTERN_hurracloud = "^${LAYERDIR}/"
BBFILE_PRIORITY_hurracloud = "6"

LAYERSERIES_COMPAT_hurracloud = "warrior zeus"
```
